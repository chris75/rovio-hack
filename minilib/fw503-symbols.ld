SECTIONS
{
   snprintf              = 0x0000B0FC;
   malloc                = 0x0000BE80;
   strcpy                = 0x0006B6D8;
   AddHttpValue          = 0x0006C34C;
   mcuSendCommand        = 0x00090970;
   ictlCtrlMCU           = 0x000B8098;
   ledShowStateError     = 0x000BDAEC;
   ledShowStatePoweredOn = 0x000BDBD4;
   prdAddTask            = 0x000C9E70;
}
